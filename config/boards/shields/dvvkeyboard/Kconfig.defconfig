## config/boards/shields/dvvkeyboard/Kconfig.defconfig
```kconfig
if SHIELD_DVVKEYBOARD

config ZMK_KEYBOARD_NAME
    default "DVV Keyboard"

endif
```

## config/boards/shields/dvvkeyboard_left/Kconfig.defconfig
```kconfig
if SHIELD_DVVKEYB_LEFT

config ZMK_DVVKEYB_LEFT
    string
    default "DVV1224"
config ZMK_SPLIT
    bool
    default y
config ZMK_SPLIT_ROLE_CENTRAL
    bool
    default y
endif

if SHIELD_DVVKEYB_RIGHT

config ZMK_DVVKEYB_RIGHT
    bool
    default y
config ZMK_SPLIT
    bool
    default y
endif

if ZMK_DISPLAY

config I2C
    bool
    default y

config SSD1306
    bool
    default y

endif # ZMK_DISPLAY
```

## config/boards/shields/dvvkeyboard_left/Kconfig.shield
```kconfig
config SHIELD_DVVKEYB_LEFT
    def_bool $(shields_list_contains, dvvkeyb_left)

config SHIELD_DVVKEYB_RIGHT
    def_bool $(shields_list_contains, dvvkeyb_right)
```

## config/west.yml
```yaml
manifest:
  defaults:
    revision: v0.2

  remotes:
    - name: zmkfirmware
      url-base: https://github.com/zmkfirmware

  projects:
    - name: zmk
      remote: zmkfirmware
      import: app/west.yml
    - name: zmk-nice-view
      remote: zmkfirmware
      revision: main
      path: app/lib/zmk-nice-view

  self:
    path: config
```
